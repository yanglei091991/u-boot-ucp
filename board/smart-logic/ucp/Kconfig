## board/smart-logic/ucp/Kconfig
```kconfig
if TARGET_UCP

config SYS_BOARD
	default "ucp"

config SYS_VENDOR
	default "smart-logic"

config SYS_CONFIG_NAME
	default "ucp_a53"

endif
```

## configs/ucp_defconfig
```kconfig
CONFIG_ARM=y
CONFIG_ARCH_UCP=y
#CONFIG_SYS_TEXT_BASE=0x10800000
CONFIG_SYS_TEXT_BASE=0x4ee0000
CONFIG_TARGET_UCP=y

# Device Tree Control
CONFIG_DEFAULT_DEVICE_TREE="ucp-board"
CONFIG_OF_CONTROL=y
# CONFIG_OF_SEPARATE is not set
CONFIG_OF_EMBED=y
CONFIG_FIT=y

# DRIVER MODEL: NET
CONFIG_DM=y
CONFIG_DM_ETH=y
CONFIG_DWC_ETH_QOS=y
CONFIG_NET=y
CONFIG_DM_DEBUG=y
CONFIG_CMD_NET=y
#CONFIG_CMD_RARP=y
#CONFIG_CMD_DHCP=y
CONFIG_CMD_NFS=y
CONFIG_CMD_PING=y
CONFIG_NET_RANDOM_ETHADDR=y
CONFIG_NETCONSOLE=y
CONFIG_NET_TFTP_VARS=y
CONFIG_PHYLIB=y
CONFIG_NETDEVICES=y
CONFIG_LIB_RAND=y

# FOR DWC NET DRIVER
CONFIG_CMD_GPIO=y
CONFIG_DM_GPIO=y
CONFIG_CLK=y
CONFIG_TEGRA186_CLOCK=y

#CONFIG_CMD_MEMTEST=y
```

## configs/ucp_gmac_defconfig
```kconfig
CONFIG_ARM=y
CONFIG_ARCH_UCP=y
CONFIG_SYS_TEXT_BASE=0x4ee0000
CONFIG_TARGET_UCP=y
CONFIG_FIT=y
CONFIG_CMD_GPIO=y
CONFIG_CMD_PING=y
CONFIG_OF_CONTROL=y
CONFIG_OF_EMBED=y
CONFIG_DEFAULT_DEVICE_TREE="ucp-board"
CONFIG_NET_RANDOM_ETHADDR=y
CONFIG_NETCONSOLE=y
CONFIG_DM=y
CONFIG_DM_DEBUG=y
CONFIG_CLK=y
CONFIG_DM_GPIO=y
CONFIG_DM_ETH=y
CONFIG_UCP_ETH=y
```

## drivers/net/ucp_eth/Kconfig
```kconfig
config UCP_ETH
	bool "UCP Ethernet driver"
	help
	  This driver provides support for UCP Ethernet.
```

## u-boot-2018.11-rc2/arch/arm/mach-ucp/ucpsoc/Kconfig
```kconfig
if ARCH_UCP

config UCPSOC
	bool
	default y

choice
	prompt "UCP board select"
	optional

config TARGET_UCP
	bool "ucp"

endchoice

config SYS_SOC
	default "ucpsoc"

source "board/smart-logic/ucp/Kconfig"

endif
```

## u-boot-2018.11-rc2/configs/ucp_defconfig
```kconfig
CONFIG_ARM=y
CONFIG_ARCH_UCP=y
#CONFIG_SYS_TEXT_BASE=0x10800000
CONFIG_SYS_TEXT_BASE=0x4e60000
#CONFIG_SYS_TEXT_BASE=0x10000000
CONFIG_TARGET_UCP=y

# Device Tree Control
CONFIG_DEFAULT_DEVICE_TREE="ucp-board"
CONFIG_OF_CONTROL=y
# CONFIG_OF_SEPARATE is not set
CONFIG_OF_EMBED=y
CONFIG_FIT=y

# DRIVER MODEL: NET
CONFIG_DM=y
CONFIG_DM_ETH=y
CONFIG_DWC_ETH_QOS=y
CONFIG_NET=y
CONFIG_DM_DEBUG=y
CONFIG_CMD_NET=y
#CONFIG_CMD_RARP=y
#CONFIG_CMD_DHCP=y
CONFIG_CMD_NFS=y
CONFIG_CMD_PING=y
CONFIG_NET_RANDOM_ETHADDR=y
CONFIG_NETCONSOLE=y
CONFIG_NET_TFTP_VARS=y
CONFIG_PHYLIB=y
CONFIG_NETDEVICES=y
CONFIG_LIB_RAND=y

# FOR DWC NET DRIVER
CONFIG_CLK=y
CONFIG_TEGRA186_CLOCK=y

#CONFIG_CMD_MEMTEST=y

CONFIG_MMC=y
CONFIG_MMC_DW=y
CONFIG_CMD_MMC=y
CONFIG_CMD_EXT2=y
CONFIG_CMD_EXT4=y
CONFIG_CMD_EXT4_WRITE=y
#CONFIG_CMD_FAT=y

CONFIG_ENV_IS_IN_EXT4=y
CONFIG_ENV_EXT4_INTERFACE="mmc"
CONFIG_ENV_EXT4_DEVICE_AND_PART="0"
CONFIG_ENV_EXT4_FILE="/uboot.env"

# FOR NAND FLASH
CONFIG_CMD_MTD=y
CONFIG_MTD=y
#CONFIG_SPI_FLASH=y
CONFIG_SPI_FLASH_GIGADEVICE=y
CONFIG_SPI_FLASH_MACRONIX=y
CONFIG_SPI_FLASH_SPANSION=y
CONFIG_SPI_FLASH_STMICRO=y
CONFIG_SPI_FLASH_WINBOND=y
CONFIG_SPI_FLASH_XMC=y
CONFIG_SPI_FLASH_MTD=y
CONFIG_MTD_UBI_BEB_LIMIT=22
CONFIG_SPI=y
CONFIG_CMD_MTDPARTS=y
#CONFIG_MTDIDS_DEFAULT="spi-nand0=spi0.0"
CONFIG_MTDPARTS_DEFAULT="spi-nand0:-(nand)"
CONFIG_DM_SPI=y
CONFIG_CMD_SPI=y
CONFIG_MTDIDS_DEFAULT="spi-nand0=spi_flash"
#CONFIG_ENV_IS_IN_SPI_FLASH=y
CONFIG_MTD_SPI_NAND=y
#CONFIG_DM_SPI_FLASH=y
CONFIG_DESIGNWARE_SPI=y

# FOR YAFFS2
CONFIG_CMD_FS_GENERIC=y
CONFIG_CMD_YAFFS2=y
CONFIG_YAFFS2=y
```
